/ {
	compatible = "acme,soc2";
	#address-cells = <1>;
	#size-cells = <1>;

	i2c1: i2c@3000 {
		compatible = "acme,soc2-i2c";
		reg = <0x3000 0x100>;
		#address-cells = <1>;
		#size-cells = <0>;
		clock-frequency = <100000>;
		status = "disabled";
	};

	spi0: spi@4000 {
		compatible = "acme,soc2-spi";
		reg = <0x4000 0x100>;
		status = "disabled";
	};
};
